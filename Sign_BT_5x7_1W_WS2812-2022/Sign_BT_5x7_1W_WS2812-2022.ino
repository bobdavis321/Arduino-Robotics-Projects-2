// For Color Text on 1wire, Series wired WS2812 strings 
// Features: Bluetooth support, 2 Lines, 5x7 Font
// by: BOB Davis January 2022

// Uses Port B for faster output of data
// Displays 2 lines of text switching between them.
// PORTB is Digital Pins 8-13 (Uses D8 actually)
// Colors: R=Red, G=Green, B=Blue, W=White
// Colors: Y=Yellow, P=Purple, C=Cyan
#include <EEPROM.h> 
#define PIN 8  // D0 of port B - Actual pin to send data on

// Variables for colors of letters and background
int red=1; int green=1; int blue=1;

// Format: R/G/B=Foreground then R/G/B=Background then 1/2=line then text
String text1="G1LINE ONE OF GREEN TEXT       ";
String text2="R2NEW PASTORS:RAFAEL+ERIKA        ";
String textn="      "; // New text

// Send the next row to the pin 8 times.
// The delay timing is for an Arduino UNO or Nano.
void sendBits( byte bits ) {
  // setting the MSB to 0 reduces brightness + power consumption
    PORTB=0x0F;  // turn on
    PORTB=0x0F;  // delay
    PORTB=0x0F;  // delay
    PORTB=0x0F;  // delay (add more for faster processors)
    PORTB=0x00;  // send data
    PORTB=0x00;  // delay
    PORTB=0x00;  // delay
    PORTB=0x00;  // delay
    PORTB=0x00;  // Turn off
    PORTB=0x00;  // Turn off
    PORTB=0x00;  // Turn off
  for (int b=0; b<7; b++) {
    PORTB=0x0F;  // turn on
    PORTB=0x0F;  // delay
    PORTB=0x0F;  // delay
    PORTB=0x0F;  // delay (add more for faster processors)
    PORTB=bits;  // send data
    PORTB=bits;  // delay
    PORTB=bits;  // delay   
    PORTB=bits;  // delay
    PORTB=0x00;  // Turn off
    PORTB=0x00;  // Turn off
    PORTB=0x00;  // Turn off
  }
}

// Send bytes to LED's, avoid loops for maximum speed!
void sendPixelCol(byte Col) {
    if (green)sendBits(Col); else sendBits(0x00);
    if (red)sendBits(Col);  else sendBits(0x00);  
    if (blue)sendBits(Col); else sendBits(0x00);  
 }

byte font5x7[][6] = {  // font from AdaFruit
    0x00, 0x00, 0x00, 0x00, 0x00, 0x00, // Space 
    0x00, 0x00, 0x5F, 0x00, 0x00, 0x00, // !
    0x00, 0x07, 0x00, 0x07, 0x00, 0x00, //"
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    0x21, 0x55, 0x55, 0x79, 0x41, 0x00,
};

void sendline(String line) {
  cli();                     // No time for interruptions!
  for (int c=0; c<8; c++){   // shift and send columns
    for (int l=2; l<14; l++){  // Send characters 
        sendPixelCol((font5x7[(line)[l]-32][0])>>c); 
        sendPixelCol((font5x7[(line)[l]-32][1])>>c); 
        sendPixelCol((font5x7[(line)[l]-32][2])>>c); 
        sendPixelCol((font5x7[(line)[l]-32][3])>>c); 
        sendPixelCol((font5x7[(line)[l]-32][4])>>c); 
        sendPixelCol((font5x7[(line)[l]-32][5])>>c); 
    }
  }
  for (int c=0; c<8; c++){   // shift and send columns
    for (int l=14; l<26; l++){  // Send characters 
        sendPixelCol((font5x7[(line)[l]-32][0])>>c); 
        sendPixelCol((font5x7[(line)[l]-32][1])>>c); 
        sendPixelCol((font5x7[(line)[l]-32][2])>>c); 
        sendPixelCol((font5x7[(line)[l]-32][3])>>c); 
        sendPixelCol((font5x7[(line)[l]-32][4])>>c); 
        sendPixelCol((font5x7[(line)[l]-32][5])>>c); 
    }
  }
  sei();
}

void setup() {
  Serial.begin(9600);    // opens serial port, data rate 9600 bps
  pinMode(PIN, OUTPUT);   // alternative set pin to output
}
void loop() {
  if (Serial.available() > 0) {
    textn=Serial.readString(); 
    for(int i = textn.length(); i < 40; i++){ textn += ' '; }
    if ((textn[1])=='1') text1=textn;
    if ((textn[1])=='2') text2=textn;
    for(int i=0 ; i < 40 ; i++)  {
      EEPROM.write( i,text1[i] ); // Write characters
      EEPROM.write( i+50,text2[i] ); // Write characters
    }
  }
  text1="";
  text2="";
  for(int i=0 ; i < 40 ; i++) { // The max length is 40
    char f=EEPROM.read(i);   // Read character
    text1 += (f); 
    char t=EEPROM.read(i+50);   // Read character
    text2 += (t); 
  }     
    Serial.println(text1);
    Serial.println(text2);
  
  
  // Pad length to 40 characters
  for(int i = text1.length(); i < 30; i++){ text1 += ' '; }
  for(int i = text2.length(); i < 30; i++){ text2 += ' '; }
  
  // Read colors from string, 
  if ((text1[0])=='R') red=1, green=0, blue=0;
  if ((text1[0])=='G') red=0, green=1, blue=0;
  if ((text1[0])=='B') red=0, green=0, blue=1;
  if ((text1[0])=='W') red=1, green=1, blue=1;
  if ((text1[0])=='Y') red=1, green=1, blue=0;
  if ((text1[0])=='P') red=1, green=0, blue=1;
  if ((text1[0])=='C') red=0, green=1, blue=1;

  sendline(text1);
  delay(4000);      // Wait to display results
     
  // Get New foreground and background colors
  if ((text2[0])=='R') red=1, green=0, blue=0;
  if ((text2[0])=='G') red=0, green=1, blue=0;
  if ((text2[0])=='B') red=0, green=0, blue=1;
  if ((text2[0])=='W') red=1, green=1, blue=1;
  if ((text2[0])=='Y') red=1, green=1, blue=0;
  if ((text2[0])=='P') red=1, green=0, blue=1;
  if ((text2[0])=='C') red=0, green=1, blue=1;
 
  sendline(text2);
  delay(4000);      // Wait to display results
  return;  
}
